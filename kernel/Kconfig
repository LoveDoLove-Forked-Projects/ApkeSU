## kernel/Kconfig
```kconfig
menu "KernelSU"

config KSU
	tristate "KernelSU function support"
	depends on KPROBES && EXT4_FS
	default y
	help
	  Enable kernel-level root privileges on Android System.
	  Requires CONFIG_KPROBES for kernel hooking support.
	  Requires CONFIG_EXT4_FS for `ext4_unregister_sysfs`.
	  To compile as a module, choose M here: the
	  module will be called kernelsu.

config KPM
	bool "Enable SukiSU KPM ABI"
	depends on KSU = y && ARM64
	default n
	select KALLSYMS
	select KALLSYMS_ALL
	help
	  Export the SukiSU-compatible KPM ABI from a built-in GKI KernelSU
	  instance. The ABI is a bridge for a separately boot-integrated KPM
	  loader; it deliberately does not embed an ELF loader in KernelSU.
	  KPM is unavailable for LKM and late-load builds.

config KSU_NATIVE_KPM
	bool
	depends on KSU = y && ARM64
	select KPM
	default n
	help
	  Deprecated compatibility symbol. Use CONFIG_KPM instead.

menu "KernelSU - SUSFS"
	depends on KSU = y && ARM64 && THREAD_INFO_IN_TASK

config KSU_SUSFS
	bool "Enable SUSFS for built-in GKI"
	default n
	help
	  Build the SUSFS kernel implementation and the ApkeSU source-hook
	  bridge into a GKI kernel. This option is intentionally unavailable
	  for LKM builds because SUSFS also patches the Android kernel VFS.

config KSU_SUSFS_SUS_PATH
	bool "Hide suspicious paths"
	depends on KSU_SUSFS
	default y

config KSU_SUSFS_SUS_MOUNT
	bool "Hide suspicious mounts"
	depends on KSU_SUSFS
	default y

config KSU_SUSFS_SUS_KSTAT
	bool "Spoof suspicious file metadata"
	depends on KSU_SUSFS
	default y

config KSU_SUSFS_SPOOF_UNAME
	bool "Spoof uname"
	depends on KSU_SUSFS
	default y

config KSU_SUSFS_ENABLE_LOG
	bool "Enable SUSFS kernel logging"
	depends on KSU_SUSFS
	default y

config KSU_SUSFS_HIDE_KSU_SUSFS_SYMBOLS
	bool "Hide KernelSU and SUSFS symbols from kallsyms"
	depends on KSU_SUSFS
	default y

config KSU_SUSFS_SPOOF_CMDLINE_OR_BOOTCONFIG
	bool "Spoof cmdline or bootconfig"
	depends on KSU_SUSFS
	default y

config KSU_SUSFS_OPEN_REDIRECT
	bool "Redirect opened paths"
	depends on KSU_SUSFS
	default y

config KSU_SUSFS_SUS_MAP
	bool "Hide suspicious mapped files"
	depends on KSU_SUSFS
	default y

endmenu

config ABK_CONTROL
	tristate "Enable ABK control interface and manager compatibility"
	depends on KSU
	default y
	help
	  Add the ABK control ABI to the KernelSU supercall interface and trust
	  the configured ABK manager package and certificate. The feature does
	  not create a user-visible device node; callers use the existing
	  KernelSU supercall file descriptor. Disable this option when the ABK
	  manager must not be trusted by a kernel build.

config KSU_DEBUG
	bool "KernelSU debug mode"
	depends on KSU
	default n
	help
	  Enable KernelSU debug mode.

config KSU_DISABLE_MANAGER
	bool "Disable KernelSU manager integration"
	depends on KSU
	default n
	help
	  Disable manager APK detection and manager-specific handling.
	  Root will be used in place of manager-only functionality.

config KSU_DISABLE_POLICY
	bool "Disable KernelSU policy profiles"
	depends on KSU
	default n
	help
	  Disable per-app root/non-root profile customization.
	  Escalation will always use the default full root profile, and
	  non-root handling will follow the global umount policy only.

config KSU_X86_PATCH_SYSCALL_DISPATCHER
	bool "Dynamically patch x64's hardened syscall dispatcher to support syscall hooks"
	depends on KSU && X86_64
	default n
	help
	  Dynamically patch x64's hardened syscall dispatcher to support syscall hooks. This is a
	  replacement for a kernel source code patch, and is useful for x86_64 LKM mode.

endmenu
```
